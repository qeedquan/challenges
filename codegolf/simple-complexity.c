/*

Output

                  #         #  #    #  # #####  ##    #
                  ##        ####    #######  #   #    ##
                ####        ##      ##    #  ### #######
                #  #         #       #    ##### ### #  #
                #  # ### #####   #####    #         #  #
                ####### ###  #  ###  #    ##        ####
                ##    #   #  ###  #  #######        ##
                 #    ##  #####   ##### #  #         #
                ##    #                   #         #  # #####
                 #    ##                  ##        #######  #
                 #######                ####        ##    #  ###
                ### #  #                #  #         #    #####
                    #  #                #  # ### #####    #
                    ####                ####### ###  #    ##
                    ##                  ##    #   #  #######
                     #                   #    ##  ##### #  #
    #  # #####  ##    #                   #
    #######  #   #    ##                  ##
    ##    #  ### #######                ####
     #    ##### ### #  #                #  #
 #####    #         #  #                #  # ###
###  #    ##        ####                #######
  #  #######        ##                  ##    #
  ##### #  #         #                   #    ##
          #         #  # #####   #####  ##    #
          ##        #######  #  ###  #   #    ##
        ####        ##    #  ###  #  ### #######
        #  #         #    #####   ##### ### #  #
        #  # ### #####    #       #         #  #
        ####### ###  #    ##      ##        ####
        ##    #   #  #######    ####        ##
         #    ##  ##### #  #    #  #         #
                                          #
                                          ##
                                        ####
                                        #  #
                                        #  # ###
                                        #######
                                        ##    #
                                         #    ##
                                 #####  ##    #
                                ###  #   #    ##
                                  #  ### #######
                                  ##### ### #  #
                                  #         #  #
                                  ##        ####
                                ####        ##
                                #  #         #
                                  #         #  #    #  # #####
                                  ##        ####    #######  #
                                ####        ##      ##    #  ###
                                #  #         #       #    #####
                                #  # ### #####   #####    #
                                ####### ###  #  ###  #    ##
                                ##    #   #  ###  #  #######
                                 #    ##  #####   ##### #  #
                                ##    #                   #
                                 #    ##                  ##
                                 #######                ####
                                ### #  #                #  #
                                    #  #                #  # ###
                                    ####                #######
                                    ##                  ##    #
                                     #                   #    ##
Trailing spaces allowed. Shortest solution wins.

*/

#include <stdio.h>

int
at(int x, int y)
{
	int c, i, t;

	c = '#';
	for (i = 0; i < 6; i++) {
		if (x >= 32) {
			if (y >= 32) {
				t = x - 32;
				x = y - 32;
				y = t;
			} else {
				c = ' ';
				break;
			}
		} else {
			if (y >= 32)
				y = 63 - y;
			else
				x = 31 - x;
		}
		x *= 2;
		y *= 2;
	}
	return c;
}

// ported from @Neil solution
void
draw(void)
{
	int x, y;

	for (x = 0; x < 64; x++) {
		for (y = 0; y < 64; y++)
			putchar(at(x, y));
		putchar('\n');
	}
}

int
main(void)
{
	draw();
	return 0;
}
