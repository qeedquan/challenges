/*

To pass the series of gates guarded by the owls, Kenneth needs to present them each with a highly realistic portrait of one. Unfortunately, he is absolutely rubbish at drawing, and needs some code to return a brand new portrait with a moment's notice.

All owl heads look like this:

''0v0''

Such beautiful eyes! However, they differ in their plumage, which is always symmetrical, eg.:

   VVHVAV''0v0''VAVHVV

or

YYAYAH8XH''0v0''HX8HAYAYY

So Kenneth needs a method that will take a garble of text generated by mashing at his keyboard (numbers and letters, but he knows how to avoid punctuation etc.) for a bit and give him a symmetrical owl with a lovely little face, with a truly symmetrical plumage made of uppercase letters and numbers.

(To be clear, the acceptable characters for the plumage are 8,W,T,Y,U,I,O,A,H,X,V and M.)

*/

#include <assert.h>
#include <stdio.h>
#include <string.h>
#include <ctype.h>

void
owlpic(const char *input, char *output)
{
	char *buffer;
	size_t length;
	int symbol;

	buffer = output;
	for (length = 0; *input; input++) {
		symbol = toupper(*input);
		if (strchr("8WTYUIOAHXVM", symbol)) {
			*buffer++ = symbol;
			length++;
		}
	}

	buffer += sprintf(buffer, "''0v0''");

	for (; length > 0; length--)
		*buffer++ = output[length - 1];

	*buffer = '\0';
}

void
test(const char *input, const char *expected)
{
	char output[128];

	owlpic(input, output);
	puts(output);
	assert(!strcmp(output, expected));
}

int
main()
{
	test("kuawd6r8q27y87t93r76352475437", "UAW8Y8T''0v0''T8Y8WAU");
	test("t6ggggggggWw", "TWW''0v0''WWT");

	return 0;
}
