/*

У Козака Вуса є нескінченна кількість зелених, жовтих та червоних яблук.

Він буде їх виставляти в один ряд за наступним алгоритмом:

Спочатку g зелених яблук, потім y жовтих, потім r червоних, потім y жовтих, потім g зелених, а потім все знову нескінченну кількість разів. Наприклад, якщо g=1, y=3, r=4, то перші яблука виглядатимуть так:

GYYYRRRRYYYGGYYYRRRRYYYGGYYYRRR...

Тобто, всі яблука можна розбити на блоки. На цьому малюнку один блок це GYYYRRRRYYYG. Зверніть увагу, що блок починається і закінчується на один і той же символ. Саме тому на першому малюнку йдуть дві G підряд попри те, що g=1.

Знайдіть колір яблука, що знаходиться на n-ій позиції.

Input
Перший рядок містить чотири цілі числа n, g, y, r (1≤n,g,y,r≤10
12
 ).

Зверніть увагу, що числа не вміщаються у 32-бітні цілочисельні типи даних. Тому потрібно використовувати 64-бітні цілочисельні типи даних, такі як long long в C++, long в Java чи int64 в Pascal.

Output
Якщо колір буде зелений, то виведіть «G».

Якщо колір буде жовтий, то виведіть «Y».

Якщо колір буде червоний, то виведіть «R».

Examples
Input #1
1 1 3 4

Answer #1
G

Input #2
2 1 3 4

Answer #2
Y

Input #3
12 1 3 4

Answer #3
G

Input #4
13 1 3 4

Answer #4
G

Input #5
20 1 3 4

Answer #5
R

Input #6
1000000000000 1 3 4

Answer #6
Y

*/

#include <assert.h>

typedef long long vlong;

vlong
solve(vlong n, vlong g, vlong y, vlong r)
{
	vlong m;

	m = (g * 2) + (y * 2) + r;
	n %= m;

	if (n <= g)
		return 'G';
	n -= g;

	if (n <= y)
		return 'Y';
	n -= y;

	if (n <= r)
		return 'R';
	n -= r;

	if (n <= y)
		return 'Y';
	n -= y;

	if (n <= g)
		return 'G';

	return 0;
}

int
main()
{
	assert(solve(1, 1, 3, 4) == 'G');
	assert(solve(2, 1, 3, 4) == 'Y');
	assert(solve(12, 1, 3, 4) == 'G');
	assert(solve(13, 1, 3, 4) == 'G');
	assert(solve(20, 1, 3, 4) == 'R');
	assert(solve(1000000000000, 1, 3, 4) == 'Y');

	return 0;
}
