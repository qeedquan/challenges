/*

Pentagonal numbers are generated by the formula, Pn=n(3n−1)/2. The first ten pentagonal numbers are:

1, 5, 12, 22, 35, 51, 70, 92, 117, 145, ...

It can be seen that P4 + P7 = 22 + 70 = 92 = P8. However, their difference, 70 − 22 = 48, is not pentagonal.

Find the pair of pentagonal numbers, Pj and Pk, for which their sum and difference are pentagonal and D = |Pk − Pj| is minimised; what is the value of D?

*/

#include <stdio.h>
#include <math.h>
#include <limits.h>

typedef unsigned long long uvlong;

uvlong
pentagonal(uvlong n)
{
	return (n * ((3 * n) - 1)) / 2;
}

int
ispentagonal(uvlong n)
{
	double x;

	x = (sqrt((24 * n) + 1) + 1) / 6;
	return x == floor(x);
}

uvlong
solve(void)
{
	uvlong i, j;
	uvlong x, y;

	for (i = 2; i < ULLONG_MAX; i++) {
		x = pentagonal(i);
		for (j = i - 1; j > 0; j--) {
			y = pentagonal(j);
			if (ispentagonal(x + y) && ispentagonal(x - y))
				return x - y;
		}
	}
	return 0;
}

int
main(void)
{
	printf("%llu\n", solve());
	return 0;
}
